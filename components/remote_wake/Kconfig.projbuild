## components/remote_wake/Kconfig.projbuild
```kconfig
menu "remote-wake"

    config RW_OTA_ENABLED
        bool "Whole-application OTA updater (application enrollment required)"
        default n
        help
            Requires application identity, explicit publisher public keys and HTTPS
            release source, A/B app slots, otadata and bootloader rollback. No keys
            or source are supplied by this component. Without publisher enrollment,
            an initialized updater only tracks boot health and rollback.

    config RW_PROFILE_POWER_ONLY
        bool "Power-button-only profile (no USB HID)"
        default y if !SOC_USB_OTG_SUPPORTED
        default n
        help
            Build without TinyUSB. The device then only implements ping,
            status, power_tap and power_hold; wake / type / keys answer
            "usb_down". This is auto-selected on targets whose SoC has no
            USB-OTG device peripheral (classic ESP32, ESP32-C3, ...).

    config RW_PWR_ENABLED
        bool "Physical PWR_SW output"
        default y
        help
            Disable on boards with no power-button circuit. No GPIO is touched;
            power commands answer the protocol v1 "internal" error.

    config RW_PWR_GPIO
        int "PWR_SW optocoupler GPIO"
        depends on RW_PWR_ENABLED
        range 0 48
        default 5
        help
            Drives the LED side of the PC817 through a 330 ohm resistor.
            Active high, idle low. See hardware/README.md.

    config RW_PC_SENSE_ENABLED
        bool "Host power-LED sense input"
        default n
        help
            Read the motherboard's PWR_LED header through an optocoupler and
            report the host as on, off or sleep (blinking LED) in the status
            response's "pc_power" field. Disabled, no GPIO is touched and the
            field reads "unknown". Sensing never gates power or HID actions.

    config RW_PC_SENSE_GPIO
        int "Power-LED sense GPIO"
        depends on RW_PC_SENSE_ENABLED
        range 0 48
        default 6
        help
            Input from the sense optocoupler's transistor. Must differ from
            the PWR_SW, setup-button and status-LED GPIOs.

    config RW_PC_SENSE_ACTIVE_LOW
        bool "Sense input is low while the host LED is lit"
        depends on RW_PC_SENSE_ENABLED
        default y
        help
            Yes for the reference circuit: the opto transistor pulls the
            input to GND while lit, against the internal pull-up. No for a
            circuit that drives the input high while lit; the internal
            pull-down is used instead.

    config RW_BOOT_GPIO
        int "Setup / factory-reset button GPIO"
        range 0 48
        default 0
        help
            Active-low button (the BOOT button on most devkits).
            Hold 5 s at boot for setup mode, 15 s for factory reset.

    config RW_LED_ENABLED
        bool "Status LED (WS2812)"
        default y
        help
            Addressable RGB status LED driven over RMT.

    config RW_LED_GPIO
        int "WS2812 status LED GPIO"
        depends on RW_LED_ENABLED
        range 0 48
        default 48
        help
            GPIO48 is the on-board RGB LED on the ESP32-S3-DevKitC-1.

    config RW_LED_MAX_BRIGHTNESS
        int "Status LED peak brightness (0-255)"
        depends on RW_LED_ENABLED
        range 1 255
        default 40
        help
            WS2812s are painfully bright; 40 is a tasteful glow.

    config RW_RELAY_URL
        string "Default relay base URL"
        default "wss://relay.example.com"
        help
            Base URL of the relay. The device connects to
            <base>/v1/device/<deviceId>. http/https are rewritten to ws/wss;
            prefer https so the pairing reply works with the app. A relay
            URL entered on the setup page is stored in NVS as an override;
            leaving it empty keeps this default. The relay.example.com
            default is a placeholder: set your deployed relay here.

    config RW_TS_WINDOW_SEC
        int "Accepted |ts - now| window in seconds"
        range 5 600
        default 90
        help
            Protocol v1 mandates 90. Changing this breaks interop.

    config RW_AUTH_FAIL_THRESHOLD
        int "Auth failures per minute before lockout"
        range 2 100
        default 5

    config RW_AUTH_LOCKOUT_SEC
        int "Auth-failure lockout duration in seconds"
        range 5 3600
        default 60

    config RW_SETUP_HOLD_MS
        int "Button hold to enter setup mode (ms)"
        default 5000

    config RW_FACTORY_HOLD_MS
        int "Button hold to factory reset (ms)"
        default 15000

endmenu
```

## firmware/main/Kconfig.projbuild
```kconfig
menu "Application firmware releases"
    depends on RW_OTA_ENABLED
    config APP_OTA_BOARD
        string "Board identity"
        default "esp32-c3" if IDF_TARGET_ESP32C3
        default "esp32" if IDF_TARGET_ESP32
        default "esp32-s3-devkitc"
    config APP_OTA_PROFILE
        string "Hardware profile identity"
        default "power-only" if RW_PROFILE_POWER_ONLY
        default "hid-power"
    config APP_OTA_CHANNEL
        string "Release channel"
        default "stable"
    config APP_OTA_RELEASE
        int "Monotonic release counter"
        range 1 2147483647
        default 1
    config APP_OTA_MANIFEST_URL
        string "Signed channel manifest HTTPS URL"
        default ""
    config APP_OTA_SOURCE_PREFIX
        string "Allowed HTTPS release repository/path prefix (ending /)"
        default ""
    config APP_OTA_KEY_ID
        string "Trusted publisher key ID"
        default "publisher-1"
    config APP_OTA_KEY_GENERATION
        int "Publisher key generation"
        range 1 2147483647
        default 1
    config APP_OTA_PUBLIC_KEY_HEX
        string "Publisher Ed25519 PUBLIC key (64 hex characters)"
        default ""
        help
            Never put a signing private key in firmware. Empty source/key fields
            enable boot health only; no downloads or update registration occur.
    config APP_OTA_AUTO
        bool "Automatically install matching signed releases"
        default n
endmenu
```

## firmware/test_apps/auth_test/sdkconfig.defaults
```kconfig
CONFIG_ESP_MAIN_TASK_STACK_SIZE=8192
CONFIG_ESP_TASK_WDT_INIT=n
CONFIG_UNITY_ENABLE_FIXTURE=n
CONFIG_LOG_DEFAULT_LEVEL_INFO=y
```
